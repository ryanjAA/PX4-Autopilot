## src/modules/mavlink/Kconfig
```kconfig
menuconfig MODULES_MAVLINK
	bool "mavlink"
	default n
	---help---
		Enable support for mavlink

menuconfig MAVLINK_DIALECT
depends on MODULES_MAVLINK
        string "Mavlink dialect"
        default "common"
	---help---
		Select the Mavlink dialect to generate and use.

config MAVLINK_M_PRIVATE_PROFILE
	bool "Dronecode MAVLink-M cue endpoint"
	default n
	depends on MODULES_MAVLINK
	---help---
		Compile the finalized Dronecode MAVLink-M cue and handover endpoint.
		The board must also select the mavlink_m dialect. Runtime operation
		remains fail-closed until MAV_M_MODE is explicitly enabled. Optional
		non-kinetic reposition authority remains disabled until MAV_M_ACTION
		is set to 1 for level transit or 2 for cue-altitude intercept, and a
		cue is locally accepted.

menuconfig MAVLINK_UAVCAN_PARAMETERS
depends on MODULES_MAVLINK && DRIVERS_UAVCAN
        bool "Mavlink UAVCAN parameter support"
        default y
	---help---
		Expose UAVCAN parameters over Mavlink.

menuconfig USER_MAVLINK
	bool "mavlink running as userspace module"
	default y
	depends on BOARD_PROTECTED && MODULES_MAVLINK
	---help---
		Put mavlink in userspace memory
```
